## hw/nikon/Kconfig
```kconfig
config NIKON_ARM
    bool

config NIKON_MEMORY
    bool
    select NIKON_ARM

config NIKON_Z7II
    bool
    default y
    depends on TCG && ARM
    select ARM_GIC
    select OR_IRQ
    select SSI
    select I2C
    select NIKON_MEMORY
    select NIKON_STORAGE
    select NIKON_EX
    select NIKON_SENSOR

config NIKON_SLA
    bool
    default y
    depends on TCG && ARM
    select ARM_GIC
    select SSI
    select I2C
    select SPLIT_IRQ
    select OR_IRQ
    select NIKON_MEMORY
    select NIKON_STORAGE

config NIKON_EX
    bool
    default y
    depends on TCG && ARM
    select NIKON_ARM
    select ARM_V7M
    select STM32F2XX_USART
    select STM32L4X5_GPIO
    select OR_IRQ
    select SSI
    select I2C

config NIKON_SENSOR
    bool
    default y
    depends on TCG && ARM
    select NIKON_ARM

config NIKON_STORAGE
    bool
    default y
    depends on TCG && ARM
    select PCI
    select NVME_PCI
    select PCI_EXPRESS_GENERIC_BRIDGE

config NIKON_VR
    bool
    default y
    depends on TCG && RX
    select RENESAS_CMT
    select SSI
```
